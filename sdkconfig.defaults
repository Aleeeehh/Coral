## sdkconfig.defaults
```kconfig
# ESP32CAM Configuration
CONFIG_ESP32CAM_AITHINKER=y
CONFIG_ESPTOOLPY_FLASHMODE_QIO=y
CONFIG_ESPTOOLPY_FLASHFREQ_80M=y
CONFIG_ESPTOOLPY_FLASHSIZE_4MB=y

# Camera Configuration
CONFIG_CAMERA_MODEL_AI_THINKER=y
CONFIG_CAMERA_PIN_PWDN=32
CONFIG_CAMERA_PIN_RESET=-1
CONFIG_CAMERA_PIN_XCLK=0
CONFIG_CAMERA_PIN_SIOD=26
CONFIG_CAMERA_PIN_SIOC=27
CONFIG_CAMERA_PIN_D7=35
CONFIG_CAMERA_PIN_D6=34
CONFIG_CAMERA_PIN_D5=39
CONFIG_CAMERA_PIN_D4=36
CONFIG_CAMERA_PIN_D3=21
CONFIG_CAMERA_PIN_D2=19
CONFIG_CAMERA_PIN_D1=18
CONFIG_CAMERA_PIN_D0=5
CONFIG_CAMERA_PIN_VSYNC=25
CONFIG_CAMERA_PIN_HREF=23
CONFIG_CAMERA_PIN_PCLK=22

# Enable camera driver
CONFIG_CAMERA_ENABLE=y
CONFIG_CAMERA_MODEL_WROVER_KIT=n
CONFIG_CAMERA_MODEL_ESP_EYE=n
CONFIG_CAMERA_MODEL_M5STACK_PSRAM=n
CONFIG_CAMERA_MODEL_AI_THINKER=y
CONFIG_CAMERA_MODEL_CUSTOM=n
CONFIG_CAMERA_MODEL_CUSTOM_PINOUT=n

# WiFi Configuration
CONFIG_ESP32_WIFI_STATIC_RX_BUFFER_NUM=10
CONFIG_ESP32_WIFI_DYNAMIC_RX_BUFFER_NUM=32
CONFIG_ESP32_WIFI_DYNAMIC_TX_BUFFER_NUM=32
CONFIG_ESP32_WIFI_TX_BA_WIN=6
CONFIG_ESP32_WIFI_RX_BA_WIN=6

# FreeRTOS Configuration
CONFIG_FREERTOS_HZ=1000
CONFIG_FREERTOS_USE_TRACE_FACILITY=y
CONFIG_FREERTOS_USE_STATS_FORMATTING_FUNCTIONS=y
CONFIG_FREERTOS_VTASKLIST_INCLUDE_COREID=y
CONFIG_FREERTOS_GENERATE_RUN_TIME_STATS=y

# HTTP Server Configuration
CONFIG_HTTPD_MAX_REQ_HDR_LEN=512
CONFIG_HTTPD_MAX_URI_LEN=512
CONFIG_HTTPD_WS_BUFFER_SIZE=1024

# Logging
CONFIG_LOG_DEFAULT_LEVEL_INFO=y
CONFIG_LOG_MAXIMUM_LEVEL_VERBOSE=y

# Configurazione per Human Face Detection
CONFIG_HUMAN_FACE_DETECT_MSRMNP_S8_V1=y
CONFIG_HUMAN_FACE_DETECT_MODEL_IN_FLASH_RODATA=y
CONFIG_DEFAULT_HUMAN_FACE_DETECT_MODEL=0

# Configurazione PSRAM per ESP32-S3
CONFIG_ESP32S3_SPIRAM_SUPPORT=y
CONFIG_SPIRAM=y
CONFIG_SPIRAM_MODE_OCT=y
CONFIG_SPIRAM_TYPE_AUTO=y
CONFIG_SPIRAM_SIZE=-1
CONFIG_SPIRAM_SPEED_80M=y
CONFIG_SPIRAM_BOOT_INIT=y
CONFIG_SPIRAM_USE_MALLOC=y
CONFIG_SPIRAM_MEMTEST=y
CONFIG_SPIRAM_MALLOC_ALWAYSINTERNAL=16384
CONFIG_SPIRAM_TRY_ALLOCATE_WIFI_LWIP=y
CONFIG_SPIRAM_MALLOC_RESERVE_INTERNAL=32768

# Configurazione memoria per ESP-DL
CONFIG_ESP_DL_MEMORY_MANAGER_GREEDY=y
CONFIG_ESP_DL_INTERNAL_RAM_SIZE=65536

# Configurazione partizione personalizzata
CONFIG_PARTITION_TABLE_CUSTOM=y
CONFIG_PARTITION_TABLE_CUSTOM_FILENAME="partitions.csv"
CONFIG_PARTITION_TABLE_OFFSET=0x8000

# Configurazione Flash size
CONFIG_ESPTOOLPY_FLASHSIZE_16MB=y 
```
